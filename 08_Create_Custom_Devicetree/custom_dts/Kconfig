## 08_Create_Custom_Devicetree/custom_dts/Kconfig
```kconfig
menuconfig POWER_SWITCH
    bool "Power switch helper"
    default y
    help
      Enable the power-switch helper library.

if POWER_SWITCH

config POWER_SWITCH_LOG_LEVEL
    int "Log level for power-switch helper"
    default 3
    range 0 4
    help
      0=NONE 1=ERR 2=WRN 3=INF 4=DBG.

endif
```

## 09_Create_Custom_Devicetree/custom_dts/dts/bindings/power-switch.yaml
```yaml
# Copyright (c) 2026 ITI Zephyr Playground
# SPDX-License-Identifier: Apache-2.0

description: GPIO pin to switch a power output on or off

compatible: "power-switch"

properties:
  gpios:
    type: phandle-array
    required: true
    description: |
      The GPIO connected to the gate driver for the MOSFET / load switch.

examples:
  - |
    / {
      load_switch: load_switch {
        compatible = "power-switch";
        gpios = <&gpioa 5 GPIO_ACTIVE_HIGH>;
      };
    };
```
