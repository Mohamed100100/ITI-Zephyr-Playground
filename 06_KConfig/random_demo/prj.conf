## CMakeLists.txt
```
cmake_minimum_required(VERSION 3.28.0)

find_package(Zephyr REQUIRED HINTS $ENV{ZEPHYR_BASE})
project(random_demo)

target_sources(app PRIVATE src/main.c)
target_include_directories(app PRIVATE ${CMAKE_CURRENT_SOURCE_DIR}/inc)
```

## Kconfig
```
source "Kconfig.zephyr"

menu "Application Configuration"

config APP_RANDOM_MAX
    int "Maximum random value (exclusive)"
    range 1 1000000
    default 100
    help
      Upper bound for the generated random numbers.
      The value is used as: sys_rand32_get() % APP_RANDOM_MAX.

config APP_RANDOM_INTERVAL_MS
    int "Interval between random numbers (ms)"
    range 100 10000
    default 1000
    help
      How often a new random number is generated.

endmenu
```

## prj.conf
```kconfig
CONFIG_TEST_RANDOM_GENERATOR=y
CONFIG_PRINTK=y
```

## src/main.c
```c
/*
 * Copyright (c) 2026 ITI Zephyr Playground
 * SPDX-License-Identifier: Apache-2.0
 *
 * Random-number demo driven by Kconfig.
 *
 * The two Kconfig options live in this app's Kconfig file:
 *   CONFIG_APP_RANDOM_MAX          -> upper bound of the random number
 *   CONFIG_APP_RANDOM_INTERVAL_MS  -> delay between numbers
 *
 * Change them in prj.conf (or with menuconfig), rebuild, and the behavior
 * changes without editing this C file.
 */

#include <zephyr/kernel.h>
#include <zephyr/random/random.h>
#include <zephyr/sys/printk.h>

#include <app_config.h>

int main(void)
{
	printk("%s started (max=%d, interval=%d ms)\n",
	       APP_BANNER,
	       CONFIG_APP_RANDOM_MAX,
	       CONFIG_APP_RANDOM_INTERVAL_MS);

	while (1) {
		uint32_t value = sys_rand32_get() % CONFIG_APP_RANDOM_MAX;

		printk("Random number: %u\n", value);
		k_msleep(CONFIG_APP_RANDOM_INTERVAL_MS);
	}

	return 0;
}
```

## inc/app_config.h
```c
#ifndef APP_CONFIG_H
#define APP_CONFIG_H

#define APP_BANNER "Random number demo"

#endif /* APP_CONFIG_H */
```
